#! armclang -E --target=arm-arm-none-eabi -mcpu=cortex-m55 -xc
; command above MUST be in first line (no comment above!)

#include "app_mem_regions.h"

#define __ROM_BASE      APP_MRAM_HE_BASE
#define __ROM_SIZE      APP_MRAM_HE_SIZE

#define __EXTFLASH_BASE APP_OSPI_FLASH_HE_BASE
#define __EXTFLASH_SIZE (APP_OSPI_FLASH_HE_SIZE + APP_OSPI_FLASH_HP_SIZE)

#define __ITCM_BASE     APP_ITCM_BASE
#define __ITCM_SIZE     APP_HE_ITCM_SIZE

#define __RAM_BASE      APP_DTCM_BASE
#define __RAM_SIZE      APP_HE_DTCM_SIZE

#define __STACK_SIZE    APP_HE_STACK_SIZE
#define __HEAP_SIZE     APP_HE_HEAP_SIZE
#define __APP_HEAP_SIZE 0x00004000

/*----------------------------------------------------------------------------
  User Stack & Heap boundary definition
 *----------------------------------------------------------------------------*/
#define __STACK_TOP     (__RAM_BASE + __RAM_SIZE)    /* starts at end of RAM */
#define __HEAP_BASE     (AlignExpr(+0, 8))           /* starts after RW_RAM section, 8 byte aligned */
#define __APP_HEAP_BASE (AlignExpr(+0, 8))           /* starts after HEAP, 8 byte aligned */


/*----------------------------------------------------------------------------
  Scatter File Definitions definition
 *----------------------------------------------------------------------------*/

#define __RW_BASE       __RAM_BASE
#define __RW_SIZE      (__RAM_SIZE - __STACK_SIZE - __HEAP_SIZE - __APP_HEAP_SIZE)

LR_ROM __ROM_BASE NOCOMPRESS __ROM_SIZE  {    ; load region size_region
  ER_ROM_VECTORS  (AlignExpr(__ROM_BASE, 2048))  {   ; Vector Table
    *vectors.o (RESET, +First)
  }

  ER_ROM (AlignExpr(+0, 8))  {                 ; load address = execution address
   *(InRoot$$Sections)

   ; These should be part of primary load region
   *startup*.o (.text*, .rodata*, .ARM.exidx*, .ARM.extab*)
   *system*.o (.text*, .rodata*, .ARM.exidx*, .ARM.extab*)
   *sys_*.o (.text*, .rodata*, .ARM.exidx*, .ARM.extab*)
   *pm.o (.text*, .rodata*, .ARM.exidx*, .ARM.extab*)
   *tgu*.o (.text*, .rodata*, .ARM.exidx*, .ARM.extab*)
   *mpu*.o (.text*, .rodata*, .ARM.exidx*, .ARM.extab*)
   *sau_tcm_ns_setup*.o (.text*, .rodata*, .ARM.exidx*, .ARM.extab*)
   *lv_*.o (.text*, .rodata*, .ARM.exidx*, .ARM.extab*)

   ; Keep ordinary application and board support code in the internal image.
   .ANY (+RO)
   .ANY (+XO)
  }

  ITCM_RAM __ITCM_BASE __ITCM_SIZE  {                     ; RW code
   ; Specify objects intended to execute out of ITCM
  }

  RW_RAM __RW_BASE __RW_SIZE  {                     ; RW data
   .ANY (+RW +ZI)
  }

  NS_REGION_0  (AlignExpr(+0, TGU_BLOCK_SIZE)) { ; Non secure region 0
    * (eth_buf)
    * (usb_dma_buf)
    * (sd_dma_buf)
    * (.driver.usbd0)
#if __HAS_BULK_SRAM == 0
    * (.bss.lcd_frame_buf)
#endif
  }

  NS_REGION_0_PAD  (AlignExpr(ImageLimit(NS_REGION_0), TGU_BLOCK_SIZE)) { ; Non secure region 0 Padding
  }
  ScatterAssert((ImageBase(NS_REGION_0_PAD) - ImageBase(NS_REGION_0) + ImageLength(RW_RAM)) < __RW_SIZE)

#if __HEAP_SIZE > 0
  ARM_LIB_HEAP  __HEAP_BASE EMPTY  __HEAP_SIZE  {   ; Reserve empty region for heap
  }
#endif

  APP_HEAP  __APP_HEAP_BASE EMPTY  __APP_HEAP_SIZE {; Reserve empty region for application heap
  }

  ARM_LIB_STACK __STACK_TOP EMPTY -__STACK_SIZE {   ; Reserve empty region for stack
  }

#if __HAS_BULK_SRAM
#if SRAM0_SRAM1_COMBINED
  RW_SRAM APP_SRAM_BASE APP_SRAM_SIZE  {  ; Update sections as needed
   * (.bss.lcd_crop_and_interpolate_buf)  ; LCD crop and interpolate image processing buffer.
   * (.bss.lcd_frame_buf)                 ; LCD frame Buffer.
   * (.bss.camera_frame_buf)              ; Camera Frame Buffer
   * (.bss.camera_frame_bayer_to_rgb_buf) ; (Optional) Camera Frame Buffer for Bayer to RGB Conversion.
  }
#else
  RW_SRAM0 APP_SRAM0_BASE APP_SRAM0_SIZE  {  ; Update sections as needed
   * (.bss.lcd_crop_and_interpolate_buf)  ; LCD crop and interpolate image processing buffer.
   * (.bss.lcd_frame_buf)                 ; LCD frame Buffer.
   * (.bss.camera_frame_buf)              ; Camera Frame Buffer
   * (.bss.camera_frame_bayer_to_rgb_buf) ; (Optional) Camera Frame Buffer for Bayer to RGB Conversion
  }

  /*
   * Note:
   * The below empty regions are ON by default, but may have been released
   * by some example applications. So make sure your application requests
   * power for these regions before adding contents.
   */

  RW_SRAM1 APP_SRAM1_BASE APP_SRAM1_SIZE  {  ; Update sections as needed

  }
#endif
#endif

  PADDING +0 OVERLAY ALIGN 16 FILL 0 16
  {
  }
}

LR_EXTFLASH __EXTFLASH_BASE NOCOMPRESS __EXTFLASH_SIZE {
  ER_EXTFLASH __EXTFLASH_BASE __EXTFLASH_SIZE {
    __flash_start__ = .;

    . = ALIGN 16;
    __embedded_models_blob_start__ = .;
    *embedded_models_blob*.o (.rodata.embedded_models*)
    __embedded_models_blob_end__ = .;

    . = ALIGN 16;
    __executorch_operators_start__ = .;
    *op_*.o (.text*, .rodata*, .ARM.exidx*, .ARM.extab*)
    *RegisterAllKernels.o (.text*, .rodata*, .ARM.exidx*, .ARM.extab*)
    *embeddingxb.o (.text*, .rodata*, .ARM.exidx*, .ARM.extab*)
    *interface.o (.text*, .rodata*, .ARM.exidx*, .ARM.extab*)
    *device_*.o (.text*, .rodata*, .ARM.exidx*, .ARM.extab*)
    *evalue.o (.text*, .rodata*, .ARM.exidx*, .ARM.extab*)
    *extended_header.o (.text*, .rodata*, .ARM.exidx*, .ARM.extab*)
    *method*.o (.text*, .rodata*, .ARM.exidx*, .ARM.extab*)
    *operator_registry.o (.text*, .rodata*, .ARM.exidx*, .ARM.extab*)
    *program*.o (.text*, .rodata*, .ARM.exidx*, .ARM.extab*)
    *pte_data_map.o (.text*, .rodata*, .ARM.exidx*, .ARM.extab*)
    *tensor*.o (.text*, .rodata*, .ARM.exidx*, .ARM.extab*)
    *tag.o (.text*, .rodata*, .ARM.exidx*, .ARM.extab*)

    . = ALIGN 16;
    *_util.o (.text*, .rodata*, .ARM.exidx*, .ARM.extab*)
    *unary_*.o (.text*, .rodata*, .ARM.exidx*, .ARM.extab*)
    *abort.o (.text*, .rodata*, .ARM.exidx*, .ARM.extab*)
    *log.o (.text*, .rodata*, .ARM.exidx*, .ARM.extab*)
    *minimal.o (.text*, .rodata*, .ARM.exidx*, .ARM.extab*)
    *platform.o (.text*, .rodata*, .ARM.exidx*, .ARM.extab*)
    *profiler.o (.text*, .rodata*, .ARM.exidx*, .ARM.extab*)
    *runtime.o (.text*, .rodata*, .ARM.exidx*, .ARM.extab*)

    . = ALIGN 16;
    *arm_nn*.o (.text*, .rodata*, .ARM.exidx*, .ARM.extab*)
    *arm_relu*.o (.text*, .rodata*, .ARM.exidx*, .ARM.extab*)
    *arm_elementwise*.o (.text*, .rodata*, .ARM.exidx*, .ARM.extab*)
    *arm_maximum*.o (.text*, .rodata*, .ARM.exidx*, .ARM.extab*)
    *arm_minimum*.o (.text*, .rodata*, .ARM.exidx*, .ARM.extab*)
    *arm_concatenation*.o (.text*, .rodata*, .ARM.exidx*, .ARM.extab*)
    *arm_convolve*.o (.text*, .rodata*, .ARM.exidx*, .ARM.extab*)
    *arm_depthwise*.o (.text*, .rodata*, .ARM.exidx*, .ARM.extab*)
    *arm_transpose_conv*.o (.text*, .rodata*, .ARM.exidx*, .ARM.extab*)
    *arm_batch_matmul*.o (.text*, .rodata*, .ARM.exidx*, .ARM.extab*)
    *arm_fully_connected*.o (.text*, .rodata*, .ARM.exidx*, .ARM.extab*)
    *arm_vector_sum*.o (.text*, .rodata*, .ARM.exidx*, .ARM.extab*)
    *arm_lstm*.o (.text*, .rodata*, .ARM.exidx*, .ARM.extab*)
    *arm_q7*.o (.text*, .rodata*, .ARM.exidx*, .ARM.extab*)
    *arm_s8*.o (.text*, .rodata*, .ARM.exidx*, .ARM.extab*)
    *arm_pad*.o (.text*, .rodata*, .ARM.exidx*, .ARM.extab*)
    *arm_avgpool*.o (.text*, .rodata*, .ARM.exidx*, .ARM.extab*)
    *arm_max_pool*.o (.text*, .rodata*, .ARM.exidx*, .ARM.extab*)
    *arm_reshape*.o (.text*, .rodata*, .ARM.exidx*, .ARM.extab*)
    *arm_svdf*.o (.text*, .rodata*, .ARM.exidx*, .ARM.extab*)
    *arm_softmax*.o (.text*, .rodata*, .ARM.exidx*, .ARM.extab*)
    *arm_transpose_s8.o (.text*, .rodata*, .ARM.exidx*, .ARM.extab*)
    *arm_nntables.o (.text*, .rodata*, .ARM.exidx*, .ARM.extab*)

    __executorch_operators_end__ = .;

    . = ALIGN 16;
    __flash_end__ = .;
  }

  ScatterAssert(ImageLimit(ER_EXTFLASH) <= (__EXTFLASH_BASE + __EXTFLASH_SIZE))
}
