#! armclang -E --target=arm-arm-none-eabi -mcpu=cortex-m55 -xc
; command above MUST be in first line (no comment above!)

#include "app_mem_regions.h"

#define __ROM_BASE      APP_MRAM_HE_BASE
#define __ROM_SIZE      APP_MRAM_HE_SIZE

#define __EXTFLASH_BASE APP_OSPI_FLASH_HE_BASE
#define __EXTFLASH_SIZE (APP_OSPI_FLASH_HE_SIZE + APP_OSPI_FLASH_HP_SIZE)

#define __ITCM_BASE     APP_ITCM_BASE
#define __ITCM_SIZE     APP_HE_ITCM_SIZE

#define __RAM_BASE      APP_DTCM_BASE
#define __RAM_SIZE      APP_HE_DTCM_SIZE

#define __STACK_SIZE    APP_HE_STACK_SIZE
#define __HEAP_SIZE     APP_HE_HEAP_SIZE
#define __APP_HEAP_SIZE 0x00004000

/*----------------------------------------------------------------------------
  User Stack & Heap boundary definition
 *----------------------------------------------------------------------------*/
#define __STACK_TOP     (__RAM_BASE + __RAM_SIZE)    /* starts at end of RAM */
#define __HEAP_BASE     (AlignExpr(+0, 8))           /* starts after RW_RAM section, 8 byte aligned */
#define __APP_HEAP_BASE (AlignExpr(+0, 8))           /* starts after HEAP, 8 byte aligned */


/*----------------------------------------------------------------------------
  Scatter File Definitions definition
 *----------------------------------------------------------------------------*/

#define __RW_BASE       __RAM_BASE
#define __RW_SIZE      (__RAM_SIZE - __STACK_SIZE - __HEAP_SIZE - __APP_HEAP_SIZE)

LR_ROM __ROM_BASE NOCOMPRESS __ROM_SIZE  {    ; load region size_region
  ER_ROM_VECTORS  (AlignExpr(__ROM_BASE, 2048))  {   ; Vector Table
    *vectors.o (RESET, +First)
  }

  ER_ROM (AlignExpr(+0, 8))  {                 ; load address = execution address
   *(InRoot$$Sections)

   ; These should be part of primary load region
   *startup*.o (.text*, .rodata*, .ARM.exidx*, .ARM.extab*)
   *system*.o (.text*, .rodata*, .ARM.exidx*, .ARM.extab*)
   *sys_*.o (.text*, .rodata*, .ARM.exidx*, .ARM.extab*)
   *pm.o (.text*, .rodata*, .ARM.exidx*, .ARM.extab*)
   *tgu*.o (.text*, .rodata*, .ARM.exidx*, .ARM.extab*)
   *mpu*.o (.text*, .rodata*, .ARM.exidx*, .ARM.extab*)
   *sau_tcm_ns_setup*.o (.text*, .rodata*, .ARM.exidx*, .ARM.extab*)
   *lv_*.o (.text*, .rodata*, .ARM.exidx*, .ARM.extab*)

   ; Keep the reset-to-first-printf path fully independent of OSPI XIP.
   *main.o (.text*, .rodata*, .ARM.exidx*, .ARM.extab*)
   *app.o (.text*, .rodata*, .ARM.exidx*, .ARM.extab*)
   *stdout*.o (.text*, .rodata*, .ARM.exidx*, .ARM.extab*)
   *retarget*.o (.text*, .rodata*, .ARM.exidx*, .ARM.extab*)
   *board_config*.o (.text*, .rodata*, .ARM.exidx*, .ARM.extab*)
   *pinconf*.o (.text*, .rodata*, .ARM.exidx*, .ARM.extab*)
   *Driver_*.o (.text*, .rodata*, .ARM.exidx*, .ARM.extab*)
   *uart*.o (.text*, .rodata*, .ARM.exidx*, .ARM.extab*)
   *UART*.o (.text*, .rodata*, .ARM.exidx*, .ARM.extab*)
   *GPIO*.o (.text*, .rodata*, .ARM.exidx*, .ARM.extab*)
   *mhu*.o (.text*, .rodata*, .ARM.exidx*, .ARM.extab*)
   *services_host*.o (.text*, .rodata*, .ARM.exidx*, .ARM.extab*)
   *services_lib_interface.o (.text*, .rodata*, .ARM.exidx*, .ARM.extab*)
   *se_services_port.o (.text*, .rodata*, .ARM.exidx*, .ARM.extab*)
   *container.o (.text*, .rodata*, .ARM.exidx*, .ARM.extab*)
   *embedded_models.o (.text*, .rodata*, .ARM.exidx*, .ARM.extab*)
   *arm_embedded_module.o (.text*, .rodata*, .ARM.exidx*, .ARM.extab*)
   *arm_memory_allocator.o (.text*, .rodata*, .ARM.exidx*, .ARM.extab*)
   *et_pal_override.o (.text*, .rodata*, .ARM.exidx*, .ARM.extab*)
   *minimal.o (.text*, .rodata*, .ARM.exidx*, .ARM.extab*)
   *platform.o (.text*, .rodata*, .ARM.exidx*, .ARM.extab*)
   ; C++ static initialization runs before main(), so the registration and
   ; validation path must not execute from OSPI before XIP is enabled.
   *RegisterAllKernels.o (.text*, .rodata*, .ARM.exidx*, .ARM.extab*)
   *operator_registry.o (.text*, .rodata*, .ARM.exidx*, .ARM.extab*)
   *evalue.o (.text*, .rodata*, .ARM.exidx*, .ARM.extab*)
   *tensor_util*.o (.text*, .rodata*, .ARM.exidx*, .ARM.extab*)
   *tensor_impl.o (.text*, .rodata*, .ARM.exidx*, .ARM.extab*)
   *tensor_layout.o (.text*, .rodata*, .ARM.exidx*, .ARM.extab*)
   *runtime.o (.text*, .rodata*, .ARM.exidx*, .ARM.extab*)
   *abort.o (.text*, .rodata*, .ARM.exidx*, .ARM.extab*)
   *profiler.o (.text*, .rodata*, .ARM.exidx*, .ARM.extab*)
   *tag.o (.text*, .rodata*, .ARM.exidx*, .ARM.extab*)
   *op_*.o (.text._Z*validate*, .ARM.exidx.text._Z*validate*)
   *op_*.o (.text._ZN10executorch7runtime*, .ARM.exidx.text._ZN10executorch7runtime*)

   ; Keep ordinary application and board support code in the internal image.
   .ANY (+RO)
   .ANY (+XO)
  }

  ITCM_RAM __ITCM_BASE __ITCM_SIZE  {                     ; RW code
   ; Specify objects intended to execute out of ITCM
  }

  RW_RAM __RW_BASE __RW_SIZE  {                     ; RW data
   .ANY (+RW +ZI)
  }

  NS_REGION_0  (AlignExpr(+0, TGU_BLOCK_SIZE)) { ; Non secure region 0
    * (eth_buf)
    * (usb_dma_buf)
    * (sd_dma_buf)
    * (.driver.usbd0)
#if __HAS_BULK_SRAM == 0
    * (.bss.lcd_frame_buf)
#endif
  }

  NS_REGION_0_PAD  (AlignExpr(ImageLimit(NS_REGION_0), TGU_BLOCK_SIZE)) { ; Non secure region 0 Padding
  }
  ScatterAssert((ImageBase(NS_REGION_0_PAD) - ImageBase(NS_REGION_0) + ImageLength(RW_RAM)) < __RW_SIZE)

#if __HEAP_SIZE > 0
  ARM_LIB_HEAP  __HEAP_BASE EMPTY  __HEAP_SIZE  {   ; Reserve empty region for heap
  }
#endif

  APP_HEAP  __APP_HEAP_BASE EMPTY  __APP_HEAP_SIZE {; Reserve empty region for application heap
  }

  ARM_LIB_STACK __STACK_TOP EMPTY -__STACK_SIZE {   ; Reserve empty region for stack
  }

#if __HAS_BULK_SRAM
#if SRAM0_SRAM1_COMBINED
  RW_SRAM APP_SRAM_BASE APP_SRAM_SIZE  {  ; Update sections as needed
   * (.bss.lcd_crop_and_interpolate_buf)  ; LCD crop and interpolate image processing buffer.
   * (.bss.lcd_frame_buf)                 ; LCD frame Buffer.
   * (.bss.camera_frame_buf)              ; Camera Frame Buffer
   * (.bss.camera_frame_bayer_to_rgb_buf) ; (Optional) Camera Frame Buffer for Bayer to RGB Conversion.
  }
#else
  RW_SRAM0 APP_SRAM0_BASE APP_SRAM0_SIZE  {  ; Update sections as needed
   * (.bss.lcd_crop_and_interpolate_buf)  ; LCD crop and interpolate image processing buffer.
   * (.bss.lcd_frame_buf)                 ; LCD frame Buffer.
   * (.bss.camera_frame_buf)              ; Camera Frame Buffer
   * (.bss.camera_frame_bayer_to_rgb_buf) ; (Optional) Camera Frame Buffer for Bayer to RGB Conversion
  }

  /*
   * Note:
   * The below empty regions are ON by default, but may have been released
   * by some example applications. So make sure your application requests
   * power for these regions before adding contents.
   */

  RW_SRAM1 APP_SRAM1_BASE APP_SRAM1_SIZE  {  ; Update sections as needed

  }
#endif
#endif

  PADDING +0 OVERLAY ALIGN 16 FILL 0 16
  {
  }
}

LR_EXTFLASH __EXTFLASH_BASE NOCOMPRESS __EXTFLASH_SIZE {
  ER_EXTFLASH __EXTFLASH_BASE __EXTFLASH_SIZE {
    __flash_start__ = .;

    . = ALIGN 16;
    __embedded_models_blob_start__ = .;
    *embedded_models_blob*.o (.rodata.embedded_models*, +First)
    __embedded_models_blob_end__ = .;

    . = ALIGN 16;
    __executorch_operators_start__ = .;
    ; Keep C++ constructor/scatter metadata and operator rodata in MRAM.
    ; Before main() the OSPI XIP window is not enabled, so external flash is
    ; limited to code that is only entered after the application enables XIP.
    *op_*.o (.text._ZN5torch8executor6native*, .text._ZZN5torch8executor6native*)
    *op_*.o (.text._ZN8cortex_m6native*, .text._ZZN8cortex_m6native*)
    *embeddingxb.o (.text*)
    *device_*.o (.text*)
    *extended_header.o (.text*)
    *method*.o (.text*)
    *program*.o (.text*)
    *pte_data_map.o (.text*)

    . = ALIGN 16;
    *unary_*.o (.text*)

    . = ALIGN 16;
    *arm_nn*.o (.text*)
    *arm_relu*.o (.text*)
    *arm_elementwise*.o (.text*)
    *arm_maximum*.o (.text*)
    *arm_minimum*.o (.text*)
    *arm_concatenation*.o (.text*)
    *arm_convolve*.o (.text*)
    *arm_depthwise*.o (.text*)
    *arm_transpose_conv*.o (.text*)
    *arm_batch_matmul*.o (.text*)
    *arm_fully_connected*.o (.text*)
    *arm_vector_sum*.o (.text*)
    *arm_lstm*.o (.text*)
    *arm_q7*.o (.text*)
    *arm_s8*.o (.text*)
    *arm_pad*.o (.text*)
    *arm_avgpool*.o (.text*)
    *arm_max_pool*.o (.text*)
    *arm_reshape*.o (.text*)
    *arm_svdf*.o (.text*)
    *arm_softmax*.o (.text*)
    *arm_transpose_s8.o (.text*)
    *arm_nntables.o (.text*)

    __executorch_operators_end__ = .;

    . = ALIGN 16;
    __flash_end__ = .;
  }

  ScatterAssert(ImageLimit(ER_EXTFLASH) <= (__EXTFLASH_BASE + __EXTFLASH_SIZE))
}
